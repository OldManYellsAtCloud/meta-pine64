## conf/distro/pp.conf
```bitbake
# require conf/distro/poky.conf
DISTRO = "pp"
DISTRO_NAME = "PinePhone distro"

DISTRO_VERSION = "0.1"

INIT_MANAGER = "systemd"
DISTRO_FEATURES += " x11 systemd opengl wifi usbhost usbgadget bluetooth 3g pulseaudio pam wayland "

DISTRO_CODENAME = "wrynose"
SDK_VENDOR = "-ppsdk"
```

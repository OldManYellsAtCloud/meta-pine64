## conf/machine/include/ppp.inc
```bitbake
SOC_FAMILY = "pppro"

require conf/machine/include/soc-family.inc

PREFERRED_PROVIDER_virtual/bootloader ?= "u-boot"
#UBOOT_BINARY ?= "u-boot-sunxi-with-spl.bin"
UBOOT_BINARY ?= "u-boot.itb"
#SPL_BINARY ?= "spl/sunxi-spl.bin"
SPL_BINARY ?= "idbloader.img"
UBOOT_ENTRYPOINT = "0x40000000"
UBOOT_DTB_LOADADDRESS = "0x4FA00000"
#UBOOT_ENTRYPOINT = "0x4000"
#UBOOT_DTB_LOADADDRESS = "0x01f00000"

UBOOT_ENV ?= "boot"
#UBOOT_ENV = "uEnv"
UBOOT_ENV_SUFFIX ?= "scr"
#UBOOT_ENV_SUFFIX = "txt"

TFA_PLATFORM = "rk3399"
TFA_BUILD_TARGET = "bl31"
```

## conf/machine/include/star64.inc
```bitbake
SOC_FAMILY = "star64"

require conf/machine/include/soc-family.inc

PREFERRED_PROVIDER_virtual/bootloader ?= "u-boot"
UBOOT_BINARY ?= "u-boot.itb"
SPL_BINARY ?= "spl/u-boot-spl.bin.normal.out"
#UBOOT_ENTRYPOINT = "0x40000000"
#UBOOT_DTB_LOADADDRESS = "0x4FA00000"
#UBOOT_ENTRYPOINT = "0x80200000"
#UBOOT_DTB_LOADADDRESS = "0x8FA00000"

UBOOT_ENTRYPOINT = "0x40200000"
UBOOT_DTB_LOADADDRESS = "0x46000000"
UBOOT_RD_LOADADDRESS = "0x46100000"

UBOOT_ENV ?= "boot"
UBOOT_ENV_SUFFIX ?= "scr"

#TFA_PLATFORM = "rk3399"
#TFA_BUILD_TARGET = "bl31"
```

## conf/machine/pinephone-1-2.conf
```bitbake
#@TYPE: Machine
#@NAME: PinePhone rev. 1.2
#@DESCRIPTION: An Allwinner based smart phone https://www.pine64.org/

require conf/machine/include/arm/armv8a/tune-cortexa53.inc
require conf/machine/include/a64.inc

DEFAULTTUNE = "cortexa53-crypto"

EXTRA_IMAGEDEPENDS += "u-boot"
UBOOT_MACHINE ?= "pinephone_defconfig"

PREFERRED_PROVIDER_virtual/kernel ?= "linux-pine64"
KERNEL_CLASSES = "kernel-fitimage"
KERNEL_IMAGETYPE = "fitImage"
KERNEL_DEVICETREE = "allwinner/sun50i-a64-pinephone-1.2.dtb"

MACHINE_EXTRA_RRECOMMENDS += "kernel-modules"

IMAGE_FSTYPES += "wic ext4.gz"
WKS_FILE ?= "pine64-bsp-image.wks"

IMAGE_BOOT_FILES ?= " \
    fitImage \
    boot.scr \
    "

WKS_FILE_DEPENDS ?= " \
    mtools-native \
    dosfstools-native \
    virtual/bootloader \
    virtual/kernel \
    "

SERIAL_CONSOLES = "115200;ttyS0"
MACHINE_FEATURES = "alsa keyboard rtc serial screen touchscreen usbgadget usbhost vfat ext2 ext3 wifi"

PACKAGECONFIG:append:pn-mesa = " lima kmsro"
```

## conf/machine/pinephonepro-1-0.conf
```bitbake
#@TYPE: Machine
#@NAME: PinePhone Pro rev. 1.0
#@DESCRIPTION: A RockChip based smart phone https://www.pine64.org/

require conf/machine/include/arm/armv8a/tune-cortexa72-cortexa53.inc
require conf/machine/include/ppp.inc

DEFAULTTUNE = "cortexa72-cortexa53-crypto"

EXTRA_IMAGEDEPENDS += "u-boot"
UBOOT_MACHINE = "pinephone-pro-rk3399_defconfig"

PREFERRED_PROVIDER_virtual/kernel ?= "linux-pine64"
KERNEL_CLASSES = "kernel-fitimage"
KERNEL_IMAGETYPE = "fitImage"
KERNEL_DEVICETREE = "rockchip/rk3399-pinephone-pro.dtb"

MACHINE_EXTRA_RRECOMMENDS += "kernel-modules"

IMAGE_FSTYPES += "wic ext4.gz"
WKS_FILE ?= "pinephonepro-bsp-image.wks"

IMAGE_BOOT_FILES ?= "fitImage"

WKS_FILE_DEPENDS ?= " \
    mtools-native \
    dosfstools-native \
    virtual/bootloader \
    virtual/kernel \
    "

SERIAL_CONSOLES = "115200;ttyS0"
MACHINE_FEATURES = "alsa keyboard rtc serial screen touchscreen usbgadget usbhost vfat ext2 ext3 wifi"

PACKAGECONFIG:append:pn-mesa = " lima kmsro"

PREFERRED_PROVIDER_pkgconfig-native = "pkgconfig-native"
```

## conf/machine/star64-mine.conf
```bitbake
#@TYPE: Machine
#@NAME: Star64
#@DESCRIPTION: Risc-V based SBC https://www.pine64.org/

require conf/machine/include/riscv/tune-riscv.inc
require conf/machine/include/star64.inc

EXTRA_IMAGEDEPENDS += "u-boot"
UBOOT_MACHINE ?= "starfive_visionfive2_defconfig"
#UBOOT_MACHINE ?= "star64_defconfig"

PREFERRED_PROVIDER_virtual/kernel ?= "linux-mystar64"
KERNEL_CLASSES = "kernel-fitimage"
KERNEL_IMAGETYPE = "fitImage"
KERNEL_DEVICETREE = "starfive/jh7110-pine64-star64.dtb"

MACHINE_EXTRA_RRECOMMENDS += "kernel-modules"

IMAGE_FSTYPES += "wic ext4.gz cpio.gz"
WKS_FILE ?= "star64-bsp-image.wks"

IMAGE_BOOT_FILES ?= " \
    fitImage \
    boot.scr \
    u-boot.itb \
    "

WKS_FILE_DEPENDS ?= " \
    mtools-native \
    dosfstools-native \
    virtual/bootloader \
    virtual/kernel \
    "

SERIAL_CONSOLES = "115200;ttyS0"
MACHINE_FEATURES = "alsa keyboard rtc serial screen usbgadget usbhost vfat ext2 ext3 wifi"

PACKAGECONFIG:append:pn-mesa = " kmsro"
```

## conf/machine/tibuta.conf
```bitbake
#@TYPE: Machine
#@NAME: PinePhone rev. 1.2
#@DESCRIPTION: An Allwinner based smart phone https://www.pine64.org/

require conf/machine/include/x86/arch-x86.inc

DEFAULTTUNE = "x86-64"
TARGET_ARCH = "x86_64"

KERNEL_CLASSES = "kernel-fitimage"
KERNEL_IMAGETYPE = "fitImage"
# KERNEL_DEVICETREE = "allwinner/sun50i-a64-pinephone-1.2.dtb"

MACHINE_EXTRA_RRECOMMENDS += "kernel-modules"

IMAGE_FSTYPES += "wic ext4.gz"
WKS_FILE ?= "tibuta.wks"

IMAGE_BOOT_FILES = "u-boot.bin fitImage"

#IMAGE_BOOT_FILES ?= " \
#    fitImage \
#    boot.scr \
#    "

WKS_FILE_DEPENDS ?= " \
    mtools-native \
    dosfstools-native \
    virtual/bootloader \
    virtual/kernel \
    "

# SERIAL_CONSOLES = "115200;ttyS0"
MACHINE_FEATURES = "acpi efi alsa keyboard rtc screen touchscreen usbhost vfat ext2 wifi bluetooth keyboard pcbios pci"
# PREFERRED_PROVIDER_virtual/bootloader ?= "grub"
```

## files/wic/star64-bsp-image.wks
```
#
# The disk layout used is:
#
#    0                   -> reserverd
#    8 KiB               -> u-boot SPL and u-boot
#    20480 KiB           -> kernel, dtbs, boot script
#    20480 KiB + 50 MiB  -> rootfs
#
# MSDOS partition table is required because the bootloader would overlap the
# GPT table
#bootloader --ptable msdos
bootloader --ptable gpt

#part spl   --offset 64                          --ondisk mmcblk1 --no-table                     --source rawcopy           --sourceparams="file=u-boot-spl.bin.normal.out"
part spl	--offset 4096 --align 2 --ondisk mmcblk1 --source rawcopy --sourceparams="file=u-boot-spl.bin.normal.out" --part-type 2E54B353-1271-4842-806F-E436D6AF6985
#part /boot --offset 16384 --size=100M --active --ondisk mmcblk1 --fstype=vfat --label pine64   --source bootimg-partition  --sourceparams="file=u-boot.itb"
part tpl  --offset 8192 --align 2 --active --ondisk mmcblk1  --source rawcopy  --sourceparams="file=u-boot.itb" --part-type BC13C2FF-59E6-4262-A352-B275FD6F7172
part /boot --offset 16384 --size=100M --active --ondisk mmcblk1 --fstype=vfat --label star64   --source bootimg-partition
part /   --align 2 --ondisk mmcblk1 --fstype=ext4 --source=rootfs --part-type EBD0A0A2-B9E5-4433-87C0-68B6B72699C7
```

## wic/pinephonepro-bsp-image.wks
```
#
# MSDOS partition table is required because the bootloader would overlap the
# GPT table
bootloader --ptable msdos


part spl   --offset 32k     --ondisk mmcblk2 --no-table --source rawcopy  --sourceparams="file=idbloader.img"
part tpl   --offset 8192k   --ondisk mmcblk2 --source rawcopy  --sourceparams="file=u-boot.itb" --no-table
part /boot --fstype=vfat --source=bootimg-partition --active --use-uuid --label boot --align 4
part --fstype=vfat --source=bootimg-partition --active --use-uuid --label boot_bak --align 4
part /  --ondisk mmcblk2 --fstype=ext4 --label system --source=rootfs --align 4 --size 3G
part --ondisk mmcblk2 --fstype=ext4 --label system_bak --source=rootfs --align 4 --size 3G
part --ondisk mmcblk2 --fstype=ext4 --label data --size 2G --align 16 --uuid ada7638a-c072-4fef-b4e2-963e23dd31b3
```

## wic/star64-bsp-image.wks
```
#
# The disk layout used is:
#
#    0                   -> reserverd
#    8 KiB               -> u-boot SPL and u-boot
#    20480 KiB           -> kernel, dtbs, boot script
#    20480 KiB + 50 MiB  -> rootfs
#
# MSDOS partition table is required because the bootloader would overlap the
# GPT table
bootloader --ptable msdos
#bootloader --ptable gpt

#part spl   --offset 64                          --ondisk mmcblk1 --no-table                     --source rawcopy           --sourceparams="file=u-boot-spl.bin.normal.out"
part spl --offset 4096s	--ondisk mmcblk1  --no-table --source rawcopy --sourceparams="file=u-boot-spl.bin.normal.out"
#part /boot --offset 16384 --size=100M --active --ondisk mmcblk1 --fstype=vfat --label pine64   --source bootimg-partition  --sourceparams="file=u-boot.itb"
part /boot  --offset 8192s --active --ondisk mmcblk1  --label pine64   --source bootimg-partition  --sourceparams="file=u-boot.itb"
part /     --align 4096  --ondisk mmcblk1 --fstype=ext4 --label platform --source=rootfs
```
